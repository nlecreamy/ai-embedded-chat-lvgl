## sdkconfig.defaults
```kconfig
# Board selection for ESP32-S3-DevKitC-1
CONFIG_BOARD_ESP32_S3_DEVKITC_1=y

# Flash size for N16R8 module (16MB Quad I/O)
CONFIG_ESPTOOLPY_FLASHSIZE="16MB"

# PSRAM configuration for N16R8 (8MB Octal PSRAM)
CONFIG_SPIRAM=y
CONFIG_SPIRAM_BOOT_INIT=y
CONFIG_SPIRAM_SPEED_80M=y
CONFIG_SPIRAM_MODE_OCT=y
CONFIG_SPIRAM_TYPE_ESP_PSRAM64=y
CONFIG_SPIRAM_SIZE=-1  # Auto-detect size

# USB Serial/JTAG console (standard for DevKitC-1)
CONFIG_ESP_CONSOLE_USB_SERIAL_JTAG=y
CONFIG_ESP_CONSOLE_USB_CDC_ON_BOOT=y

# Partition table (default single-app for simplicity)
CONFIG_PARTITION_TABLE_SINGLE_APP=y
CONFIG_PARTITION_TABLE_OFFSET=0x10000

# CPU and cache (default 240MHz, optimized cache for S3)
CONFIG_ESP_DEFAULT_CPU_FREQ_MHZ=240
CONFIG_ESP32S3_INSTRUCTION_CACHE_8KB=y
CONFIG_ESP32S3_DATA_CACHE_8KB=y
CONFIG_ESP32S3_INSTRUCTION_CACHE_LINE_32B=y
CONFIG_ESP32S3_DATA_CACHE_LINE_32B=y

# Compiler and build optimizations (performance-focused)
CONFIG_COMPILER_OPTIMIZATION_PERF=y
CONFIG_COMPILER_CXX_EXCEPTIONS=y
CONFIG_COMPILER_STACK_CHECK_MODE_NONE=y

# Heap and memory management
CONFIG_ESP_SYSTEM_ALLOW_RTC_FAST_MEM_AS_HEAP=y
CONFIG_ESP_SYSTEM_PSRAM_AS_HEAP=y
CONFIG_ESP_HEAP_POISONING_DISABLED=y

# FreeRTOS defaults
CONFIG_FREERTOS_HZ=1000
CONFIG_FREERTOS_CORETIMER_0=y
CONFIG_FREERTOS_UNICORE=n
CONFIG_FREERTOS_CHECK_STACKOVERFLOW_CANARY=y
CONFIG_FREERTOS_THREAD_LOCAL_STORAGE_POINTERS=1

# Logging
CONFIG_LOG_DEFAULT_LEVEL_INFO=y
CONFIG_LOG_COLORS=y
CONFIG_LOG_TIMESTAMP_SOURCE_RTOS=y

# Wi-Fi defaults (enabled with basic optimizations)
CONFIG_ESP_WIFI_ENABLED=y
CONFIG_ESP_WIFI_STATIC_NETIF_IP_NUM=1
CONFIG_ESP_WIFI_SSID_MAX_LEN=32
CONFIG_ESP_WIFI_NVS_ENABLED=y
CONFIG_ESP_WIFI_AMPDU_TX_ENABLED=y
CONFIG_ESP_WIFI_AMPDU_RX_ENABLED=y

# Bluetooth defaults (enabled for BLE/classic)
CONFIG_BT_ENABLED=y
CONFIG_BT_BLUEDROID_ENABLED=y
CONFIG_BT_NIMBLE_ENABLED=n
CONFIG_BT_CLASSIC_ENABLED=y
CONFIG_BT_BLE_ENABLED=y
CONFIG_BT_BLUEDROID_STACK_NO_LOG=y

# Power management (light sleep enabled by default)
CONFIG_PM_ENABLE=y
CONFIG_PM_TRACE=y
CONFIG_PM_PROFILING=y
CONFIG_MAC_BB_PD=y
CONFIG_ESP_PM_TRACE=y

# Security (disabled by default for development; enable as needed)
CONFIG_SECURE_BOOTLOADER_ENABLED=n
CONFIG_SECURE_FLASH_ENC_ENABLED=n
CONFIG_ESP_SECURE_BOOT_V2_ENABLED=n

# App update and OTA (basic support)
CONFIG_BOOTLOADER_APP_ROLLBACK_ENABLE=y
CONFIG_APP_UPDATE_TP_OTA_SUPPORTED=y

# System panic and reboot
CONFIG_ESP_SYSTEM_PANIC_SILENT_REBOOT=y
CONFIG_ESP_SYSTEM_PANIC_PRINT_HALT=y
CONFIG_ESP_SYSTEM_RESTART_AFTER_PANIC=y
```
